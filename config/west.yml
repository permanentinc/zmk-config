## config/west.yml
```yaml
manifest:
  remotes:
    - name: zmkfirmware
      url-base: https://github.com/zmkfirmware
    - name: permanentinc
      url-base: https://github.com/permanentinc
  projects:
    - name: zmk
      remote: zmkfirmware
      revision: v0.3
      import: app/west.yml
    - name: zmk-nice-oled
      remote: permanentinc
      revision: main
  self:
    path: config
```
